/**
 * @cliArgs --board "/boards/LAUNCHXL_F280039C" --device "F28003x" --part "F28003x_100PZ" --package "100PZ" --context "system" --product "C2000WARE@5.04.00.00"
 * @versions {"tool":"1.23.0+4000"}
 */

/**
 * Import the modules used in this configuration.
 */
const gpio             = scripting.addModule("/driverlib/gpio.js", {}, false);
const gpio1            = gpio.addInstance();
const gpio2            = gpio.addInstance();
const gpio3            = gpio.addInstance();
const inputxbar_input  = scripting.addModule("/driverlib/inputxbar_input.js", {}, false);
const inputxbar_input1 = inputxbar_input.addInstance();
const spi              = scripting.addModule("/driverlib/spi.js", {}, false);
const spi1             = spi.addInstance();
const sysctl           = scripting.addModule("/driverlib/sysctl.js");

/**
 * Write custom configuration values to the imported modules.
 */
gpio1.$name     = "led";
gpio1.$hardware = system.deviceData.board.components.LED4;
gpio1.direction = "GPIO_DIR_MODE_OUT";

gpio2.$name             = "cs1";
gpio2.direction         = "GPIO_DIR_MODE_OUT";
gpio2.writeInitialValue = true;
gpio2.initialValue      = 1;
gpio2.gpioPin.$assign   = "boosterpack1.31";

gpio3.$name             = "cs2";
gpio3.direction         = "GPIO_DIR_MODE_OUT";
gpio3.writeInitialValue = true;
gpio3.initialValue      = 1;

inputxbar_input1.$name          = "myINPUTXBARINPUT0";
inputxbar_input1.inputxbarInput = "XBAR_INPUT4";
inputxbar_input1.inputxbarGpio  = "GPIO23";

spi1.$hardware             = system.deviceData.board.components.BP_SITE_2.subComponents.SPI;
spi1.$name                 = "mySPIS";
spi1.useInterfacePins      = ["SPI@_CLK","SPI@_SIMO","SPI@_SOMI","SPI@_STE"];
spi1.registerInterrupts    = true;
spi1.enabledFIFOInterrupts = ["SPI_INT_RXFF"];
spi1.emulationMode         = "SPI_EMULATION_STOP_AFTER_TRANSMIT";
spi1.txFifo                = "SPI_FIFO_TXFULL";
spi1.rxFifo                = "SPI_FIFO_RXFULL";
spi1.useInterrupts         = false;
spi1.dataWidth             = "8";
spi1.useCase               = "STANDARD";
spi1.picoQual.$name        = "myGPIOQUAL4";
spi1.pociQual.$name        = "myGPIOQUAL5";
spi1.clkQual.$name         = "myGPIOQUAL6";
spi1.pteQual.$name         = "myGPIOQUAL7";
spi1.spi.$assign           = "SPIB";

/**
 * Pinmux solution for unlocked pins/peripherals. This ensures that minor changes to the automatic solver in a future
 * version of the tool will not impact the pinmux you originally saw.  These lines can be completely deleted in order to
 * re-solve from scratch.
 */
gpio1.gpioPin.$suggestSolution        = "boosterpack2.53";
gpio3.gpioPin.$suggestSolution        = "boosterpack2.58";
spi1.spi.spi_picoPin.$suggestSolution = "boosterpack2.55";
spi1.spi.spi_pociPin.$suggestSolution = "boosterpack2.54";
spi1.spi.spi_clkPin.$suggestSolution  = "boosterpack2.47";
spi1.spi.spi_ptePin.$suggestSolution  = "boosterpack2.59";
